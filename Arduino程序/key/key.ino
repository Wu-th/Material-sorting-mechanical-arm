/*
 * 项目名称：物料分拣机械臂
 * 程序描述：主控部分程序
 *          接收树莓派处理后的图像信息，进而控制舵机驱动和显示对应信息
 * 硬件介绍：Arduino Nano主板、PCA9685驱动板、0.96寸OLED12864显示模块
 * Arduino版本：1.8.9
 * 注释日期：2022.03.04
 * by：wu@@@
 */
#include <Wire.h>
#include <Arduino.h>
#include <MultiLCD.h>
#include <Adafruit_PWMServoDriver.h>

// called this way, it uses the default address 0x40
Adafruit_PWMServoDriver pwm = Adafruit_PWMServoDriver();
// you can also call it with a different address you want
//Adafruit_PWMServoDriver pwm = Adafruit_PWMServoDriver(0x41);

/*
 * 舵机角度数组
 * 包含四个位置的角度参数
 */
static const  int  angle0[5]  = {180,80,350,300,450};         //初始位置
//static const  uint16_t  angleq[5]  = {180,120,400,180,450}; //抓取位置
static const  int  anglez[5]  = {180,110,370,130,450};        //抓取位置
static const  int  angle1[5]  = {340,110,370,130,450};        //物块1放置位置
static const  int  angle2[5]  = {410,110,370,130,450};        //物块2放置位置
static const  int  angle3[5]  = {450,110,370,130,450};        //物块3放置位置
// our servo # counter
uint8_t servonum = 5;                                         //舵机数目
uint8_t yanchi = 100;                                         //角度移动延迟时间
int yanchi1 = 1500;                                        //抓取松开延迟时间
int zhuadegree = 350;
int songdegree = 280;

void servomove(int *m ,int *n);                               //1-4舵机移动函数
void servomove1(int *m ,int *n);                              //0号舵机移动函数

/*
 * 按键设置
 */
const int keyyanse = 9;     // 连接按键的引脚
const int keymianji = 10;     // 连接按键的引脚
const int keyfuwei = 11;     // 连接按键的引脚

const int ledyanse =  12;      // 连接LED的引脚
const int ledmianji =  13;      // 连接LED的引脚

// 变量定义
int buttonState = 0;         // 存储按键状态的变量
int buttonState1 = 0;         // 存储按键状态的变量
int buttonState2 = 0;         // 存储按键状态的变量
int state = 0;
/*
 * 串口通信设置
 */
char c = 0;                                                   //通信接收
int yanchis = 250;                                     //发送间隔时间

/*
 * 显示设置
 */
LCD_SSD1306 lcd; /* for SSD1306 OLED module */
//LCD_PCD8544 lcd; /* for LCD4884 shield or Nokia 5100 screen module */
//LCD_1602 lcd; /* for LCD1602 shield */
//LCD_ZTOLED lcd; /* for ZT OLED module */
//LCD_ILI9325D lcd;

static const PROGMEM uint8_t Blue[64*32] = {
 //C:\Users\taihu\Desktop\b2.bmp(0)

0x00,0x00,0x00,0xF0,0xF0,0xF0,0xF0,0xF0,0xF0,0xF0,0xF0,0xF0,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0x00,
0x00,0x00,0x00,0x00,0x00,0x00,0x00,0x00,0x00,0x00,0x00,0x00,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0x00,
0xFC,0xFC,0xFC,0xFC,0x00,0x00,0x00,0x00,0x00,0x00,0x80,0xC0,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0x00,
0x00,0x00,0x00,0xFF,0xFF,0xFF,0xFF,0x00,0x00,0x00,0x00,0x00,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0xF8,
0xF8,0xF8,0xFF,0xFF,0xFF,0xFF,0xF8,0xF8,0xF8,0xF8,0xF8,0xF8,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0x00,
0x00,0x00,0x00,0x00,0x00,0x00,0x00,0x00,0x00,0x00,0x00,0x00,0x00,0x00,0x00,0x00,0x00,0x00,0x00,0x00,0x00,0x00,0x00,0x00,0x00,0x00,0x00,0x00,0x00,0x00,0x00,0x00,0x00,0x00,0x00,0x00,0x00,0x00,0x00,0x00,0x00,0x00,0x00,0x00,0x00,0x00,0x00,0x00,0x00,0x00,0x00,0x00,0x00,0x00,0x00,0x00,0x00,0x00,0x00,0x00,0x00,0x00,0x00,0x00,0x00,0x00,0x00,0x00,0x00,0x00,0x00,0x00,0x00,0x00,0x00,0x00,0x00,0x00,0x00,0x00,//"C:\Users\taihu\Desktop\b2.bmp",0
/* (96 X 36 )*/
};                                              //蓝色
static const PROGMEM uint8_t Red[64*32] = {
 //C:\Users\taihu\Desktop\R2.bmp(0)

0x00,0x00,0x00,0x00,0x00,0x00,0x00,0x00,0x00,0x00,0x00,0x00,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0xFC,
0xFC,0x00,0x00,0x00,0x00,0x00,0x00,0x00,0x00,0x00,0x00,0x00,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0x00,
0xC0,0xF0,0xF0,0xF8,0xFC,0xFC,0x7C,0x7C,0x7C,0x7C,0x7C,0x7C,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0x78,
0x78,0x78,0x78,0x78,0x78,0x7B,0x7F,0x7F,0x7F,0x7F,0x00,0x00,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0xFF,
0xFE,0xF8,0xE0,0x00,0x00,0x00,0x00,0x07,0x1F,0x3F,0x7F,0x7F,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0x00,
0x00,0x00,0x00,0x00,0x00,0x00,0x00,0x00,0x00,0x00,0x00,0x00,0x00,0x00,0x00,0x00,0x00,0x00,0x00,0x00,0x00,0x00,0x00,0x00,0x00,0x00,0x00,0x00,0x00,0x00,0x00,0x00,0x00,0x00,0x00,0x00,0x00,0x00,0x00,0x00,0x00,0x00,0x00,0x00,0x00,0x00,0x00,0x00,0x00,0x00,0x00,0x00,0x00,0x00,0x00,0x00,0x00,0x00,0x00,0x00,0x00,0x00,0x00,0x00,0x00,0x00,0x00,0x00,0x00,0x00,0x00,0x00,0x00,0x00,0x00,0x00,0x00,0x00,0x00,0x00,//"C:\Users\taihu\Desktop\R2.bmp",0
/* (96 X 36 )*/
};                                               //红色
static const PROGMEM uint8_t Yellow[64*32] = {
 //C:\Users\taihu\Desktop\Y2.bmp(0)

0x00,0x00,0x00,0x00,0x00,0x00,0x00,0x00,0x00,0x00,0x00,0x00,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0x00,
0x00,0x00,0x00,0x00,0x00,0x00,0x00,0x00,0x00,0x00,0x00,0x00,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0x00,
0x00,0x80,0xC0,0xC0,0xE0,0xE0,0xE0,0xE0,0xE0,0xE0,0xE0,0xE0,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0x00,
0x00,0x00,0x00,0x00,0x00,0xFF,0xFF,0xFF,0xFF,0xFF,0x00,0x00,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0x00,
0x1E,0x1E,0x1E,0x1E,0x1E,0x1F,0x1F,0x1F,0x1F,0x1E,0x1E,0x1E,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0x00,
0x00,0x00,0x00,0x00,0x00,0x00,0x00,0x00,0x00,0x00,0x00,0x00,0x00,0x00,0x00,0x00,0x00,0x00,0x00,0x00,0x00,0x00,0x00,0x00,0x00,0x00,0x00,0x00,0x00,0x00,0x00,0x00,0x00,0x00,0x00,0x00,0x00,0x00,0x00,0x00,0x00,0x00,0x00,0x00,0x00,0x00,0x00,0x00,0x00,0x00,0x00,0x00,0x00,0x00,0x00,0x00,0x00,0x00,0x00,0x00,0x00,0x00,0x00,0x00,0x00,0x00,0x00,0x00,0x00,0x00,0x00,0x00,0x00,0x00,0x00,0x00,0x00,0x00,0x00,0x00,//"C:\Users\taihu\Desktop\Y2.bmp",0
/* (96 X 36 )*/
};                                              //黄色
static const PROGMEM uint8_t Green[64*32] = {
// C:\Users\taihu\Desktop\oled12864\G1.bmp(0)

0x00,0x00,0x00,0x00,0x00,0x00,0x00,0x80,0xC0,0xE0,0xF0,0xF0,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0x00,
0x00,0x00,0x00,0x00,0x00,0x00,0x00,0x00,0x00,0x00,0x00,0x00,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0x3C,
0x3C,0x3C,0x3C,0x7C,0xFC,0xF8,0xF0,0xE0,0x00,0x00,0x00,0x00,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0x1E,
0x1E,0x1E,0x1E,0x9F,0x9F,0x9F,0x1F,0x00,0x00,0x7F,0xFF,0xFF,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0x07,
0x00,0x00,0x00,0x00,0x00,0x00,0x00,0x00,0x00,0x03,0x07,0x07,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0x00,
0x00,0x00,0x00,0x00,0x00,0x00,0x00,0x00,0x00,0x00,0x00,0x00,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0x00,//C:\Users\taihu\Desktop\oled12864\G1.bmp
/* (96 X 36 )*/
};                                               //绿色
static const PROGMEM uint8_t wrong[64*32] = {
// C:\Users\taihu\Desktop\×.bmp(0)

0x00,0x00,0x00,0x00,0x00,0x00,0x00,0x00,0x00,0x00,0x00,0x00,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0x00,
0x00,0x00,0x00,0x00,0x00,0x00,0x00,0x00,0x00,0x00,0x00,0x00,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0x00,
0x00,0x00,0x00,0x00,0x00,0x00,0x00,0x00,0x00,0x00,0x00,0x00,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0xFF,
0xFB,0xE1,0x80,0x00,0x00,0x00,0x00,0x00,0x00,0x00,0x00,0x00,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0x00,
0x00,0x00,0x00,0x00,0x40,0x70,0x78,0x7E,0x7F,0x1F,0x07,0x03,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0x00,
0x00,0x00,0x00,0x00,0x00,0x00,0x00,0x00,0x00,0x00,0x00,0x00,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0x00,//C:\Users\taihu\Desktop\×.bmp,0
/* (96 X 36 )*/
};                                               //X
static const PROGMEM uint8_t right[64*32] = {
// C:\Users\taihu\Desktop\√.bmp(0)

0x00,0x00,0x00,0x00,0x00,0x00,0x00,0x00,0x00,0x00,0x00,0x00,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0x00,
0x00,0x00,0x00,0x00,0x00,0x00,0x00,0x00,0x00,0x00,0x00,0x00,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0x00,
0x00,0x00,0x00,0x00,0x00,0x00,0x00,0x00,0x00,0x00,0x00,0x00,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0x00,
0xF0,0xFF,0xFF,0x0F,0x00,0x00,0x00,0x00,0x00,0x00,0x00,0x00,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0x00,
0x00,0x00,0x00,0x00,0x00,0x00,0x00,0x00,0x00,0x00,0x00,0x00,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0x00,
0x00,0x00,0x00,0x00,0x00,0x00,0x00,0x00,0x00,0x00,0x00,0x00,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0x00,//C:\Users\taihu\Desktop\√.bmp,0
/* (96 X 36 )*/
};                                              //√


void setup() {
  // put your setup code here, to run once:
  //通信设置波特率
  Serial.begin(9600);
  //按键初始化
  pinMode(keyyanse,OUTPUT);
  pinMode(keymianji,OUTPUT);
  pinMode(keyfuwei,OUTPUT);
  pinMode(ledyanse,OUTPUT);
  pinMode(ledmianji,OUTPUT);
  digitalWrite(keyyanse,HIGH);
  digitalWrite(keymianji,HIGH);
  digitalWrite(keyfuwei,HIGH);
  //舵机PWM初始化
  pwm.begin();  
  pwm.setPWMFreq(60);                                         // Analog servos run at ~60 Hz updates
  yield();
    /*
   * 2021-04-16
   * 第一次机械臂整体位置调试，参数设置机械臂整体直角
   * 初始位置
   * 参数：                          范围
    pwm.setPWM(0, 0, 180);      //200~375
    pwm.setPWM(1, 0, 80);       //80-100
    pwm.setPWM(2, 0, 350);      //350-500
    pwm.setPWM(3, 0, 300);      //200-375
    pwm.setPWM(4, 0, 450);      //200-375  
    pwm.setPWM(5, 0, 220);      //200~255   较为精确  
  */    
    pwm.setPWM(0, 0, 180);      //200~375
    pwm.setPWM(1, 0, 80);       //80-100
    pwm.setPWM(2, 0, 350);      //350-500
    pwm.setPWM(3, 0, 300);      //200-375
    pwm.setPWM(4, 0, 450);      //200-375  
    pwm.setPWM(5, 0, songdegree);      //200~255   较为精确 
    delay(1000); 
  //显示初始化
  lcd.begin();
  lcd.clear();  
 
}

void loop() {
  // put your main code here, to run repeatedly:
  buttonState = digitalRead(keyyanse);
  buttonState1 = digitalRead(keymianji);
  buttonState2 = digitalRead(keyfuwei);
  if(buttonState == LOW)
  {
    delay(5);
    if(buttonState == LOW)
    {
      state = 1;
    }
  }
  if(buttonState1 == LOW)
  {
    delay(5);
    if(buttonState1 == LOW)
    {
      state = 2;
    }
  }
  if(buttonState2 == LOW)
  {
    delay(5);
    if(buttonState2 == LOW)
    {
      state = 3;
    }
  }  
  switch(state)
  {
    case 1: yanse1();  break;
    case 2: lunkuo1(); break;
    case 3: fuwwei1(); break;
  }
  while (Serial.available() > 0)//串口接收到数据
  {
      c = Serial.read();//获取串口接收到的数据
      if (c == 'r')
      {
          delay(5);
          if(c == 'r')
          {
            lcd.clear(); 
            lcd.draw(Red,16,14,97,37);
            delay(10);          
            fangxia();
            zhuaqu();
            taiqi();
            fangzhir();
            fangxia();
            songkai();
            taiqi();
            fanhuir();
            //Serial.print(c);             //向树莓派发送信息
            //c=0;            
          }
      }
      else if (c == 'g')
      {
         delay(5);
         if(c == 'g')
         {
           lcd.clear(); 
           lcd.draw(Green,16,14,97,37);
           delay(10);
           fangxia();
           zhuaqu();
           taiqi();          
           fangzhig();
           fangxia();
           songkai();
           taiqi();
           fanhuig();
           //Serial.print(c);             //向树莓派发送信息
           //c=0;            
          }
      }
      if(c == 'w')
          {
            delay(5);
            if(c == 'w')
            {
               lcd.clear(); 
               lcd.draw(wrong,16,14,97,37); 
               delay(10);          
               fangxia();
               zhuaqu();
               taiqi();
               fangzhig();
               fangxia();
               songkai();
               taiqi();
               fanhuig();
               //Serial.print(c);             //向树莓派发送信息                       
            }
          }
      if(c == 'd')
          {
            delay(5);
            if(c == 'd')
            {
               lcd.clear(); 
               lcd.draw(right,16,14,97,37); 
               fuwei();     
            }
          }                                  
  }   
}
void yanse1()
{
  state = 0;  
  digitalWrite(12,HIGH);
  digitalWrite(13,LOW);
  Serial.println('Y');
  delay(yanchis);
}
void lunkuo1()
{
  state = 0;  
  digitalWrite(12,LOW);
  digitalWrite(13,HIGH);
  Serial.println('L');
  delay(yanchis);
}
void fuwwei1()
{
  state = 0;  
  digitalWrite(12,LOW);
  digitalWrite(13,LOW);
  lcd.clear();
  fuwei(); 
}
void fangxia()                                      //放下函数
{
      servomove(angle0,anglez);
}
void taiqi()                                        //抬起函数
{
    servomove(anglez,angle0);
}
void fangzhir()                                     //红色放置函数
{ 
    servomove1( angle0, angle1); 
}
void fanhuir()                                      //红返回
{ 
    servomove1( angle1, angle0);      
}
void fangzhig()                                     //绿放
{ 
    servomove1( angle0, angle2); 
}
void fanhuig()                                      //绿返回
{ 
    servomove1( angle2, angle0);      
}
void fangzhiy()                                     //黄色放下
{ 
    servomove1( angle0, angle3); 
}
void fanhuiy()                                      //黄色返回
{ 
    servomove1( angle3, angle0);      
}
void servomove(int *m ,int *n)                      //1-4舵机移动函数
{
    int i = 0,d = 0;
  for(i=1;i<5;i++)
  {
    d = *(m+i);    
    if(d >= *(n+i))
    {
      if(d == *(n+i))
      {
        pwm.setPWM(i,0,d);
        delay(yanchi);
      }
        else
        {
          for(;d > *(n+i);d = d-5)
          {
            pwm.setPWM(i,0,d);
            delay(yanchi);
          }
        }
    }
    else
    {
      for(;d < *(n+i);d = d+5)
      {
        pwm.setPWM(i,0,d);
        delay(yanchi);
      }
    }
//    Serial.print( i );
//    Serial.print(" ");
//    Serial.println( d );    
  }  
}
void servomove1(int *m ,int *n)                     //底座舵机移动函数
{
    int i = 0,d = 0;
    d = *m;   
    if(d >= *n)
    {
      if(d == *n)
      {
        pwm.setPWM(i,0,d);
        delay(yanchi);
      }
        else
        {
          for(;d > *n;d = d-5)
          {
            pwm.setPWM(i,0,d);
            delay(yanchi);
          }
        }
    }
    else
    {
      for(;d < *n;d = d+5)
      {
        pwm.setPWM(i,0,d);
        delay(yanchi);
      }
    }
//    Serial.print( i );
//    Serial.print(" ");
//    Serial.println( d ); 
}
void zhuaqu()                                       //手抓抓取函数
{
  pwm.setPWM(5,0,zhuadegree);
  delay(yanchi1);
}
void songkai()                                      //手抓松开函数
{
  pwm.setPWM(5,0,songdegree);
  delay(yanchi1);
}
void  fuwei()
{
    pwm.setPWM(0, 0, 180);      //200~375
    pwm.setPWM(1, 0, 80);       //80-100
    pwm.setPWM(2, 0, 350);      //350-500
    pwm.setPWM(3, 0, 300);      //200-375
    pwm.setPWM(4, 0, 450);      //200-375  
    pwm.setPWM(5, 0, songdegree);      //200~255   较为精确 
    delay(1000);
}
